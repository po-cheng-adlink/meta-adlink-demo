## conf/distro/adlink.conf
```bitbake
# ADLINK Distro
require conf/distro/poky.conf

DISTRO = "adlink"
DISTRO_NAME = "ADLINK i.MX Release Distro"
DISTRO_VERSION = "5.10-hardknott-adlink"

# Use systemd as default init manager
INIT_MANAGER = "systemd"
PREFERRED_PROVIDER_udev = "systemd"
PREFERRED_PROVIDER_udev-utils = "systemd"
```
