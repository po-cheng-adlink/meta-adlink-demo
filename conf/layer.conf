## conf/layer.conf
```bitbake
# We have a conf and classes directory, add to BBPATH
BBPATH .= ":${LAYERDIR}"

# We have a packages directory, add to BBFILES
BBFILES += "${LAYERDIR}/recipes-*/*/*.bb \
            ${LAYERDIR}/recipes-*/*/*.bbappend"

BBFILE_COLLECTIONS += "adlink-demo"

BBFILE_PATTERN_adlink-demo := "^${LAYERDIR}"
BBFILE_PRIORITY_adlink-demo = "10"
LAYERVERSION_adlink-demo = "4"
LAYERSERIES_COMPAT_adlink-demo = "kirkstone mickledore scarthgap"

BBFILES_DYNAMIC += " \
    desktop-distro:${LAYERDIR}/dynamic-layers/meta-nxp-desktop/*/*/*.bb \
    desktop-distro:${LAYERDIR}/dynamic-layers/meta-nxp-desktop/*/*/*.bbappend \
    intel:${LAYERDIR}/dynamic-layers/meta-intel/*/*/*.bb \
    intel:${LAYERDIR}/dynamic-layers/meta-intel/*/*/*.bbappend \
"
```
